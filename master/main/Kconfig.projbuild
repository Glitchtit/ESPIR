## master/main/Kconfig.projbuild
```kconfig
menu "ESPIR Configuration"

config ESPIR_SLOT_COUNT
    int "Number of IR storage slots"
    default 32
    range 1 64

config ESPIR_IR_TX_GPIO
    int "SZHJW transmitter DAT GPIO"
    default 6

config ESPIR_IR_RX_GPIO
    int "VS1838B receiver OUT GPIO"
    default 4

config ESPIR_LEARN_TIMEOUT_MS
    int "Learn-mode timeout (ms)"
    default 15000

config ESPIR_SEND_HOLD_MS
    int "Send hold time (ms) — repeat each send this long, like holding a remote key"
    default 300
    help
        On send, the frame is retransmitted until this much time has elapsed (0 = single shot).
        Mimics holding the button so appliances that need several frames respond reliably.

config ESPIR_OLED_ENABLE
    bool "Enable 0.91\" SSD1306 status OLED (master)"
    default y

config ESPIR_OLED_SDA_GPIO
    int "OLED I2C SDA GPIO"
    depends on ESPIR_OLED_ENABLE
    default 22

config ESPIR_OLED_SCL_GPIO
    int "OLED I2C SCL GPIO (module 'SCK' pin)"
    depends on ESPIR_OLED_ENABLE
    default 23

config ESPIR_OLED_I2C_ADDR
    hex "OLED I2C address"
    depends on ESPIR_OLED_ENABLE
    default 0x3C

endmenu
```

## master/sdkconfig.defaults
```kconfig
# --- Zigbee: Router (coordinator/router build) ---
CONFIG_ZB_ENABLED=y
CONFIG_ZB_ZCZR=y
CONFIG_ZB_RADIO_NATIVE=y

# --- Partition table with Zigbee storage ---
CONFIG_PARTITION_TABLE_CUSTOM=y
CONFIG_PARTITION_TABLE_CUSTOM_FILENAME="partitions.csv"
CONFIG_PARTITION_TABLE_OFFSET=0x8000

# --- Flash ---
CONFIG_ESPTOOLPY_FLASHSIZE_4MB=y
CONFIG_ESPTOOLPY_FLASHSIZE="4MB"

# --- Recommended for Zigbee timing ---
CONFIG_FREERTOS_HZ=1000
```

## slave-pcb/main/Kconfig.projbuild
```kconfig
menu "ESPIR Configuration"

config ESPIR_SLOT_COUNT
    int "Number of IR storage slots"
    default 32
    range 1 64

config ESPIR_IR_TX_GPIO
    int "IR transmitter DAT GPIO (drives the MOSFET gate on the custom PCB)"
    default 18

config ESPIR_SEND_HOLD_MS
    int "Send hold time (ms) — repeat each send this long, like holding a remote key"
    default 300
    help
        On send, the frame is retransmitted until this much time has elapsed (0 = single shot).
        Mimics holding the button so appliances that need several frames respond reliably.

config ESPIR_BATTERY_ADC_GPIO
    int "Battery sense ADC GPIO (BAT+ via 1:2 divider; XIAO A0 = GPIO0)"
    default 0
    range 0 6
    help
        ADC1 GPIO that reads the LiPo through a 200k:200k (1:2) divider from BAT+ to GND.
        On the XIAO ESP32-C6 use A0 (GPIO0). Must be an ADC1 pin (GPIO0–6).

config ESPIR_BATTERY_DIV_X100
    int "Battery divider ratio ×100 = (R_top + R_bottom) * 100 / R_bottom"
    default 200
    help
        200 = a 1:2 divider (two equal resistors, e.g. 1M:1M or 200k:200k). For unequal
        resistors compute (R_top + R_bottom) * 100 / R_bottom, e.g. 1M(top):55k(bottom) = 1918.
        R_top goes from BAT+ to the ADC pin; R_bottom from the ADC pin to GND.

config ESPIR_XIAO_EXT_ANTENNA
    bool "XIAO ESP32-C6: use external U.FL antenna (else onboard ceramic)"
    default n
    help
        The XIAO ESP32-C6 has an RF switch: GPIO3 must be LOW to enable it, and GPIO14
        selects the antenna (LOW = onboard ceramic, HIGH = external U.FL). Without this the
        radio can't reach the network. Enable this only if you've attached the U.FL antenna.

menu "RGB status LED (custom PCB)"

config ESPIR_LED_R_GPIO
    int "RGB LED red GPIO (XIAO D7 = GPIO17)"
    default 17

config ESPIR_LED_G_GPIO
    int "RGB LED green GPIO (XIAO D8 = GPIO19)"
    default 19

config ESPIR_LED_B_GPIO
    int "RGB LED blue GPIO (XIAO D9 = GPIO20)"
    default 20

config ESPIR_LED_COMMON_ANODE
    bool "RGB LED is common-anode (active-low). Unset = common-cathode (active-high)."
    default n
    help
        Common-anode LEDs share the positive pin and light when the GPIO is driven LOW, so the
        firmware inverts the PWM duty. Common-cathode LEDs share GND and light on a HIGH GPIO.

endmenu

endmenu
```

## slave-pcb/sdkconfig.defaults
```kconfig
# --- Zigbee: End Device ---
CONFIG_ZB_ENABLED=y
CONFIG_ZB_ZED=y
CONFIG_ZB_RADIO_NATIVE=y

# --- Partition table with Zigbee storage (dual-slot OTA) ---
CONFIG_PARTITION_TABLE_CUSTOM=y
CONFIG_PARTITION_TABLE_CUSTOM_FILENAME="partitions.csv"
CONFIG_PARTITION_TABLE_OFFSET=0x8000

# --- OTA: dual-slot app rollback (new image must self-confirm or bootloader reverts) ---
CONFIG_BOOTLOADER_APP_ROLLBACK_ENABLE=y

# --- Flash ---
CONFIG_ESPTOOLPY_FLASHSIZE_4MB=y
CONFIG_ESPTOOLPY_FLASHSIZE="4MB"

# --- Recommended for Zigbee timing ---
CONFIG_FREERTOS_HZ=1000

# --- Console on the native USB-Serial-JTAG (so logs appear on /dev/ttyACM0) ---
CONFIG_ESP_CONSOLE_USB_SERIAL_JTAG=y

# --- Power management (battery sleepy end device) ---
# Sleep is join-safe in firmware: the device only sleeps after it has joined (CAN_SLEEP is
# ignored during commissioning), so it both joins reliably and saves power afterwards.
CONFIG_PM_ENABLE=y
CONFIG_FREERTOS_USE_TICKLESS_IDLE=y
CONFIG_PM_SLP_IRAM_OPT=y
```

## slave/main/Kconfig.projbuild
```kconfig
menu "ESPIR Configuration"

config ESPIR_SLOT_COUNT
    int "Number of IR storage slots"
    default 32
    range 1 64

config ESPIR_IR_TX_GPIO
    int "IR transmitter DAT GPIO"
    default 18

config ESPIR_SEND_HOLD_MS
    int "Send hold time (ms) — repeat each send this long, like holding a remote key"
    default 300
    help
        On send, the frame is retransmitted until this much time has elapsed (0 = single shot).
        Mimics holding the button so appliances that need several frames respond reliably.

config ESPIR_BATTERY_ADC_GPIO
    int "Battery sense ADC GPIO (BAT+ via 1:2 divider; XIAO A0 = GPIO0)"
    default 0
    range 0 6
    help
        ADC1 GPIO that reads the LiPo through a 200k:200k (1:2) divider from BAT+ to GND.
        On the XIAO ESP32-C6 use A0 (GPIO0). Must be an ADC1 pin (GPIO0–6).

config ESPIR_BATTERY_DIV_X100
    int "Battery divider ratio ×100 = (R_top + R_bottom) * 100 / R_bottom"
    default 200
    help
        200 = a 1:2 divider (two equal resistors, e.g. 1M:1M or 200k:200k). For unequal
        resistors compute (R_top + R_bottom) * 100 / R_bottom, e.g. 1M(top):55k(bottom) = 1918.
        R_top goes from BAT+ to the ADC pin; R_bottom from the ADC pin to GND.

config ESPIR_XIAO_EXT_ANTENNA
    bool "XIAO ESP32-C6: use external U.FL antenna (else onboard ceramic)"
    default n
    help
        The XIAO ESP32-C6 has an RF switch: GPIO3 must be LOW to enable it, and GPIO14
        selects the antenna (LOW = onboard ceramic, HIGH = external U.FL). Without this the
        radio can't reach the network. Enable this only if you've attached the U.FL antenna.

endmenu
```

## slave/sdkconfig.defaults
```kconfig
# --- Zigbee: End Device ---
CONFIG_ZB_ENABLED=y
CONFIG_ZB_ZED=y
CONFIG_ZB_RADIO_NATIVE=y

# --- Partition table with Zigbee storage ---
CONFIG_PARTITION_TABLE_CUSTOM=y
CONFIG_PARTITION_TABLE_CUSTOM_FILENAME="partitions.csv"
CONFIG_PARTITION_TABLE_OFFSET=0x8000

# --- Flash ---
CONFIG_ESPTOOLPY_FLASHSIZE_4MB=y
CONFIG_ESPTOOLPY_FLASHSIZE="4MB"

# --- Recommended for Zigbee timing ---
CONFIG_FREERTOS_HZ=1000

# --- Console on the native USB-Serial-JTAG (so logs appear on /dev/ttyACM0) ---
CONFIG_ESP_CONSOLE_USB_SERIAL_JTAG=y

# --- Power management (battery sleepy end device) — DISABLED for now ---
# Sleeping during commissioning was preventing the ED from joining, so the slave runs as a
# non-sleepy end device (radio on) until join + transmit are verified. Re-enable these to
# make it sleepy for battery use (gated by CONFIG_PM_ENABLE in firmware), then re-test join.
# CONFIG_PM_ENABLE=y
# CONFIG_FREERTOS_USE_TICKLESS_IDLE=y
# CONFIG_PM_SLP_IRAM_OPT=y
```
